## config/west.yml
```yaml
manifest:
  remotes:
    - name: zmkfirmware
      url-base: https://github.com/zmkfirmware
    - name: badjeff
      url-base: https://github.com/badjeff
    - name: pukuhei
      url-base: https://github.com/pukuhei
    #左手にdongle_displayを採用するために、englmaxiとte9noを追加した．(FIXME：両方必要か要確認．．)
    - name: englmaxi
      url-base: https://github.com/englmaxi
    - name: te9no
      url-base: https://github.com/te9no
    # トラックボール誤爆防止の実装を目的としてyamaryu211を追加
    - name: yamaryu211
      url-base: https://github.com/yamaryu211
  projects:
    - name: zmk
      remote: zmkfirmware
      revision: v0.3
      import: app/west.yml
    - name: zmk-pmw3610-driver
      remote: badjeff
      revision: zmk-0.3
    - name: zmk-tom-oled
      remote: pukuhei
      revision: main
    # 左手にdongle_displayを採用するために、te9noを追加した
    - name: zmk-dongle-display
      remote: te9no
      revision: main
    # トラボ誤爆防止の実装を目的としてyamaryu211を追加
    - name: zmk-input-processor-temp-layer-threshold
      remote: yamaryu211
      revision: main
  self:
    path: config
```
